## Documentation/devicetree/bindings/edac/cdns,ddr-edac.yaml
```yaml
# SPDX-License-Identifier: (GPL-2.0-only OR BSD-2-Clause)
%YAML 1.2
---
$id: http://devicetree.org/schemas/edac/cdns,ddr-edac.yaml#
$schema: http://devicetree.org/meta-schemas/core.yaml#

title: Cadence DDR EDAC

maintainers:
  - Paul Louvel <paul.louvel@bootlin.com>

description:
  The Cadence DDR supports DDR2 and DDR3 memory with or without ECC.
  The bootloader must configure ECC mode in the memory controller.

  The memory controller supports SECDED (single bit error correction, double bit
  error detection). ECC scrubbing has to be done via software.

properties:
  compatible:
    items:
      - const: renesas,r9a06g032-ddr-edac # RZ/N1D
      - const: cdns,ddr-edac

  reg:
    maxItems: 1

  interrupts:
    maxItems: 1

  clocks:
    items:
      - description: DDR controller clock
      - description: APB internal bus clock

  clock-names:
    items:
      - const: ddrc
      - const: pclk

required:
  - compatible
  - reg
  - interrupts
  - clocks
  - clock-names

additionalProperties: false

examples:
  - |
    #include <dt-bindings/interrupt-controller/arm-gic.h>
    #include <dt-bindings/clock/r9a06g032-sysctrl.h>

    memory-controller@4000d000 {
      compatible = "renesas,r9a06g032-ddr-edac", "cdns,ddr-edac";
      reg = <0x4000d000 0x1000>;
      interrupts = <GIC_SPI 76 IRQ_TYPE_LEVEL_HIGH>;
      clocks = <&sysctrl R9A06G032_CLK_DDRC>, <&sysctrl R9A06G032_HCLK_DDRC>;
      clock-names = "ddrc", "pclk";
    };
```
